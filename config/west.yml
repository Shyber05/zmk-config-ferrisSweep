## config/west.yml
```yaml
manifest:
  remotes:
    - name: zmkfirmware-townk
      url-base: https://github.com/Townk
  projects:
    - name: zmk
      remote: zmkfirmware-townk
      revision: mousemove
      clone-depth: 1
      import: app/west.yml

    self:
      path: config
```
